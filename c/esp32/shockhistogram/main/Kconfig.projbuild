## c/esp32/shockhistogram/main/Kconfig.projbuild
```kconfig
menu "Shock Histogram Controller Config"

config NUM_HISTOGRAM_BUCKETS
    int "Num Histogram Buckets"
    default 7
    help
        Select the number of histogram buckets to generate for each input. This must be odd.

config WEB_SERVER_PORT
    int "Controller Web Server Port (TCP)"
    default 80
    help
	Select the TCP port used the embedded web server 

choice ESP_WIFI_MODE
    prompt "AP or STA (client)"
    default ESP_WIFI_IS_STATION
    help
        Whether the esp32 is softAP or station.

config ESP_WIFI_IS_SOFTAP
    bool "SoftAP"
config ESP_WIFI_IS_STATION
    bool "Station"
endchoice

config ESP_WIFI_MODE_AP
    bool
    default y if ESP_WIFI_IS_SOFTAP
    default n if ESP_WIFI_IS_STATION

config ESP_WIFI_SSID
    string "WiFi SSID"
    default "myssid"
    help
	SSID (network name) for the example to connect to.

config ESP_WIFI_PASSWORD
    string "WiFi Password"
    default "mypassword"
    help
	WiFi password (WPA or WPA2) for the example to use.
		
config MAX_STA_CONN
    int "Max STA conn"
    default 4
    help
	Max number of the STA connects to AP.

endmenu
```
